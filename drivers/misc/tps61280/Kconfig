## drivers/misc/tps61280/Kconfig
```kconfig
#
# TPS61280 Driver
#

config TPS61280
        tristate "TI TPS61280 configuration"
        depends on I2C
        select REGMAP_I2C
        help
          This driver supports TPS61280 voltage regulator chip. This
	  driver is meant for basic configuration only and does not provide
	  any pm/regulator/thermal framework registration.
```
